## main/KConfig.projbuild
```kconfig
menu "Example Configuration"
    config EXAMPLE_ESP_WIFI_SSID
        string "WIFI SSID"
        default "wifi"
        help
            WIFI SSID

    config EXAMPLE_ESP_WIFI_PASS
        string "WIFI PASSWORD"
        default "password"
        help
            WIFI PASSWORD

    config EXAMPLE_FIRMWARE_FILE_NAME
        string "FIRMWARE FILE NAME"
        default "firmware_v1.0.0_esp32p4.bin"
        help
            firmware file name

    config EXAMPLE_STORAGE_FILE_NAME
        string "STORAGE FILE NAME"
        default "storage_v1.0.0_esp32p4.bin"
        help
            storage file name

        
    config EXAMPLE_GITHUB_HOSTNAME
        string "The Hostname of the Github Repository"
        default "api.github.com"
        help
            The Hostname of the Github API Server

    config EXAMPLE_GITHUB_OWNER
        string "The User or Organization of the Github Repository"
        default "ShenRen"
        help
            The User or Organization of the Github Repository

    config EXAMPLE_GITHUB_REPO
        string "The Repository of the Github Repository"
        default "esp_ghota_example"
        help
            The Repository of the Github Repository

    config EXAMPLE_GITHUB_AUTH_TOKEN
        bool "USE GITHUB AUTH TOKEN"
        default n
        help
            Github Personal Access Tokens to overcome Github API Ratelimits

    config EXAMPLE_GITHUB_USERNAME
        string "GITHUB USERNAME"
        depends on EXAMPLE_GITHUB_AUTH_TOKEN
        default "User Name"
        help
            Insert GH Username

    config EXAMPLE_GITHUB_PAT_TOKEN
        string "GITHUB PAT TOKEN"
        depends on EXAMPLE_GITHUB_AUTH_TOKEN
        default "PAT Token"
        help
            insert PAT TOKEN

    config EXAMPLE_DO_BACKGROUND_UPDATE
        bool "DO BACKGROUND UPDATE"
        default y
        help
            Do background update checks

    config EXAMPLE_DO_FORGROUND_UPDATE
        bool "DO FORGROUND UPDATE"
        default n
        help
            Do forground update 
    
    config EXAMPLE_DO_MANUAL_UPDATE
        bool "DO MANUAL UPDATE CHECK"
        default n
        help
            Do manual update checks
endmenu
```

## sdkconfig.defaults.esp32p4
```kconfig
CONFIG_COMPILER_OPTIMIZATION_PERF=y

# wifi remote
CONFIG_ESP_WIFI_REMOTE_LIBRARY_HOSTED=y

CONFIG_SDIO_RESET_ACTIVE_HIGH=y
CONFIG_ESP_SDIO_GPIO_RESET_SLAVE=22
CONFIG_ESP_SDIO_4_BIT_BUS=y
CONFIG_ESP_SDIO_BUS_WIDTH=4
CONFIG_ESP_SDIO_CLOCK_FREQ_KHZ=40000
CONFIG_ESP_SDIO_PIN_CMD=19
CONFIG_ESP_SDIO_PIN_CLK=18
CONFIG_ESP_SDIO_PIN_D0=14
CONFIG_ESP_SDIO_PIN_D1=15
CONFIG_ESP_SDIO_PIN_D2=16
CONFIG_ESP_SDIO_PIN_D3=17

CONFIG_ESP_WIFI_SOFTAP_SUPPORT=y

CONFIG_ESP_SDIO_OPTIMIZATION_RX_STREAMING_MODE=y
CONFIG_ESP_SDIO_HOST_INTERFACE=y
CONFIG_SLAVE_CHIPSET_ESP32C6=y
CONFIG_IDF_SLAVE_TARGET="esp32c6"
```
